## loopback_os/project-spec/configs/rootfsconfigs/Kconfig.user
```kconfig
menu "user packages " 
config gpio-demo  
	 bool "gpio-demo"
	 help
	
config loopback-test  
	 bool "loopback-test"
	 help
	
config peekpoke  
	 bool "peekpoke"
	 help
	
endmenu
```
